## main/Kconfig.projbuild
```kconfig
menu "Access point configuration"

    config ESP_WIFI_SSID
        string "WiFi SSID"
        default "myssid"
        help
            SSID (network name) for the example to connect to.

    config ESP_WIFI_PASSWORD
        string "WiFi Password"
        default "mypassword"
        help
            WiFi password (WPA or WPA2) for the example to use.
    config ESP_WIFI_CHANNEL
        int "WiFi Channel"
        range 1 13
        default 1
        help
            WiFi channel (network channel) for the example to use.

    config ESP_MAX_STA_CONN
        int "Maximal STA connections"
        default 4
        help
            Max number of the STA connects to AP.
endmenu

menu "RFID card reader"

    config ESP_RFID_MISO
        int "RFID Reader SPI MISO GPIO"
        default 19
        range 0 40
        help
            SPI MISO GPIO to interface the RFID reader.

    config ESP_RFID_MOSI
        int "RFID Reader SPI MOSI GPIO"
        default 23
        range 0 40
        help
            SPI MOSI GPIO to interface the RFID reader.

    config ESP_RFID_SCK
        int "RFID Reader SPI SCK GPIO"
        default 18
        range 0 40
        help
            SPI SCK GPIO to interface the RFID reader.   

    config ESP_RFID_SDA
        int "RFID Reader SPI SDA GPIO"
        default 5
        range 0 40
        help
            SPI SDA GPIO to interface the RFID reader.
endmenu

menu "WEBAPP Configuration"
    config EXAMPLE_MDNS_HOST_NAME
        string "mDNS Host Name"
        default "att-sys"
        help
            Specify the domain name used in the mDNS service.
            Note that webpage also take it as a part of URL where it will send GET/POST requests to.
    
    config EXAMPLE_WEB_MOUNT_POINT
        string "Website mount point in VFS"
        default "/www"
        help
            Specify the mount point in VFS.
endmenu


menu "RTC configuration"
    config RTC_I2C_MASTER_SCL
        int "SCL GPIO Number"
        default 5 if IDF_TARGET_ESP8266
        default 6 if IDF_TARGET_ESP32C3
        default 19 if IDF_TARGET_ESP32 || IDF_TARGET_ESP32S2 || IDF_TARGET_ESP32S3
        help
            GPIO number for I2C Master clock line.

    config RTC_I2C_MASTER_SDA
        int "SDA GPIO Number"
        default 4 if IDF_TARGET_ESP8266
        default 5 if IDF_TARGET_ESP32C3
        default 18 if IDF_TARGET_ESP32 || IDF_TARGET_ESP32S2 || IDF_TARGET_ESP32S3
        help
            GPIO number for I2C Master data line.
endmenu
```
